#include <avr/pgmspace.h>

#define SCROLLSPEED 40

static const char PROGMEM  font5x8[] = {

0x00, 0x00, 0x00, 0x00, 0x00,// (spacja)

0x00, 0x00, 0x5F, 0x00, 0x00,// !
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0x08, 0x1C, 0x2A, 0x08, 0x08 // <-

};

char dispString[32];

//Pins for 74HC595
int latchPin = 4;
int dataPin = 3;
int clockPin = 2;

//Pins for TPIC6B595DW
int latchPin2 = A2;
int dataPin2 = A1;
int clockPin2 = A0;

//Enable pins for TPIC6B595DW
int enablePWM1 = 5; //Left LED matrix
int enablePWM2 = 6; //Right LED matrix

char rowNum;
char selection;

//These parameters are used by the TIMER1 interrupt routine to decide to shift a text or graphic buffer
char mode;
#define TEXT 0
#define GRAPHIC 1

void initTimer(){
  cli();
  TCCR1A = 0;
  TCCR1B = 0;
  TCNT1 = 0;
  
  OCR1A = 30; 
  TCCR1B |= (1 << WGM12);
  TCCR1B |= (1 << CS12) | (1 << CS10);
  TIMSK1 |= (1 << OCIE1A);  
  
  sei();
}

void setup() {
  
  pinMode(latchPin, OUTPUT);
  pinMode(dataPin, OUTPUT);
  pinMode(clockPin, OUTPUT);

  pinMode(latchPin2, OUTPUT);
  pinMode(dataPin2, OUTPUT);
  pinMode(clockPin2, OUTPUT);

  pinMode(enablePWM1, OUTPUT);
  pinMode(enablePWM2, OUTPUT);

  digitalWrite(enablePWM1, LOW);
  digitalWrite(enablePWM2, LOW);

  digitalWrite(latchPin, LOW);
  digitalWrite(latchPin2, LOW);
//
//  shiftOut(dataPin, clockPin, LSBFIRST, 0b01010000);
//  shiftOut(dataPin, clockPin, LSBFIRST, 0b00000110);
//  shiftOut(dataPin2, clockPin2, LSBFIRST, 0b01010000);//row
//  shiftOut(dataPin2, clockPin2, LSBFIRST, 0b00000100);//row
//  digitalWrite(latchPin, HIGH);
//  digitalWrite(latchPin2, HIGH);

  initTimer();
  selection = 1;
  rowNum = 0;
  
  sprintf(dispString, "Andee");
   
  mode = 2;
}


int buffer[8];
int graphic[8];

//this array is for TPIC6B595DW
int row[8] = {
  0b1000000010000000,
  0b0100000001000000,
  0b0010000000100000,
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  0b0000000100000001,
};

int smiley[8] = {
  0b0000001111000000,
  0b0000010000100000,
  0b0000101001010000,
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  0b0000001111000000,
};

int smiley2[8] = {
  0b0000001111000000,
  0b0000010000100000,
  0b0000101001010000,
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  0b0000001111000000,
};


int love1[8] = {
  0b0000011111000000,
  0b0000000100000000,
  0b0000000100000000,
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  0b0000011111000000,
};


int love2[8] = {
  0b00000110001100000,
  0b00001111011110000,
  0b00001111111110000,
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  0b00000000100000000,
};

void shiftBuffer(uint8_t data){
  uint8_t j;
  //shift data for each row of buffer
  
  for(uint8_t k=0; k<8; k++){
    buffer[k] <<= 1;
    buffer[k] |= ((data>>k & 0x01));  
  }
}

void shiftGraphic(int *data){
  
  //shift data for each row of buffer
  
  for(uint8_t k=0; k<8; k++){
    graphic[k] = data[k];
    
  }
}

void scrollChar(char c){
  c -= 32;
  for(uint8_t i=0; i<5; i++){
    shiftBuffer(pgm_read_byte((char*)((int)font5x8 + (5*c) + i)));
    delay(SCROLLSPEED);
  }
}
void scrollString(char * myString)	//Function that scrolls a given string onto the display
{
  
  while (*myString)			//Repeat until a null character is encountered (signals end of a string)
  {
    scrollChar(*myString);
    if(*myString != 'i'){
      shiftBuffer(0x00);
      delay(SCROLLSPEED);
    }
    ++myString;				//Increment the point which tracks where we are in the string
  }

}
void scrollClear(void)			//Function that clears the display by shifting everything left
{
  for(uint8_t i=0; i<16; i++)
  {
    shiftBuffer(0x00);
    delay(SCROLLSPEED);
  }
}



void loop() 
{
  mode = GRAPHIC;
  shiftGraphic(love1);
  delay(800);
  shiftGraphic(love2);
  delay(800);
  
  mode = TEXT;
  scrollString("TO MAKE!");
  scrollClear();
  
}

void updateShiftRegisterScroll(int i){
  digitalWrite(latchPin, LOW);
  
  shiftOut_Int(dataPin, clockPin, LSBFIRST, buffer[i]);
 
  digitalWrite(latchPin2, LOW);
  
  shiftOut_Int(dataPin2, clockPin2, LSBFIRST, row[i]);
  digitalWrite(latchPin, HIGH);
  digitalWrite(latchPin2, HIGH);
}


void updateShiftRegisterGraphic(int i){
  digitalWrite(latchPin, LOW);
  
  shiftOut_Int(dataPin, clockPin, LSBFIRST, graphic[i]);
 
  digitalWrite(latchPin2, LOW);
  
  shiftOut_Int(dataPin2, clockPin2, LSBFIRST, row[i]);
  digitalWrite(latchPin, HIGH);
  digitalWrite(latchPin2, HIGH);
}


ISR(TIMER1_COMPA_vect){
  if(mode == TEXT)
    updateShiftRegisterScroll(rowNum);
  else
    updateShiftRegisterGraphic(rowNum);
  rowNum++;
  if(rowNum >= 8)
    rowNum = 0;
  
  
}

void shiftOut_Int(uint8_t dataPin, uint8_t clockPin, uint8_t bitOrder, uint16_t val)
{
    uint8_t i;

    for (i = 0; i < 16; i++)  {
      if (bitOrder == LSBFIRST)
        digitalWrite(dataPin, !!(val & (1 << i)));
      else      
        digitalWrite(dataPin, !!(val & (1 << (15 - i))));
            
      digitalWrite(clockPin, HIGH);
      digitalWrite(clockPin, LOW);            
    }
}
